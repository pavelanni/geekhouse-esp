## main/Kconfig.projbuild
```kconfig
menu "Geekhouse Configuration"

    config GEEKHOUSE_WIFI_SSID
        string "WiFi SSID"
        default "myssid"
        help
            Default WiFi network name. This is used as the initial value
            stored in NVS on first boot. Can be changed at runtime.

    config GEEKHOUSE_WIFI_PASSWORD
        string "WiFi Password"
        default "mypassword"
        help
            Default WiFi password. This is used as the initial value
            stored in NVS on first boot. Can be changed at runtime.

endmenu
```

## sdkconfig.defaults
```kconfig
# ESP32-C3 Target Configuration
CONFIG_IDF_TARGET="esp32c3"

# Console Configuration
CONFIG_ESP_CONSOLE_USB_SERIAL_JTAG=y

# FreeRTOS Configuration (for Task 1 - Stats Monitor)
CONFIG_FREERTOS_USE_TRACE_FACILITY=y
CONFIG_FREERTOS_GENERATE_RUN_TIME_STATS=y
CONFIG_FREERTOS_USE_STATS_FORMATTING_FUNCTIONS=y

# Task Watchdog (for Task 5 - Watchdog Integration)
CONFIG_ESP_TASK_WDT=y
CONFIG_ESP_TASK_WDT_TIMEOUT_S=10
CONFIG_ESP_TASK_WDT_CHECK_IDLE_TASK_CPU0=y
CONFIG_ESP_TASK_WDT_PANIC=y

# Logging
CONFIG_LOG_DEFAULT_LEVEL_INFO=y

# Optimization
CONFIG_COMPILER_OPTIMIZATION_SIZE=y
```
